## net/rfkill/Kconfig
```kconfig
FASTVC-BENCH-CORPUS:linux-main-100k-v1-e0bd41dc-8e12-4f1b-978d-a3645ae59da0
#
# RF switch subsystem configuration
#
menuconfig RFKILL
	tristate "RF switch subsystem support"
	help
	  Say Y here if you want to have control over RF switches
	  found on many WiFi, Bluetooth and IRDA cards.

	  To compile this driver as a module, choose M here: the
	  module will be called rfkill.

config RFKILL_INPUT
	tristate "Input layer to RF switch connector"
	depends on RFKILL && INPUT
	help
	  Say Y here if you want kernel automatically toggle state
	  of RF switches on and off when user presses appropriate
	  button or a key on the keyboard. Without this module you
	  need a some kind of userspace application to control
	  state of the switches.

	  To compile this driver as a module, choose M here: the
	  module will be called rfkill-input.
```

## net/wireless/Kconfig
```kconfig
FASTVC-BENCH-CORPUS:linux-main-100k-v1-e0bd41dc-8e12-4f1b-978d-a3645ae59da0
config CFG80211
        tristate "Improved wireless configuration API"

config WIRELESS_EXT
	bool "Wireless extensions"
	default n
	---help---
	  This option enables the legacy wireless extensions
	  (wireless network interface configuration via ioctls.)

	  Wireless extensions will be replaced by cfg80211 and
	  will be required only by legacy drivers that implement
	  wireless extension handlers.

	  Say N (if you can) unless you know you need wireless
	  extensions for external modules.
```

## net/xfrm/Kconfig
```kconfig
FASTVC-BENCH-CORPUS:linux-main-100k-v1-e0bd41dc-8e12-4f1b-978d-a3645ae59da0
#
# XFRM configuration
#
config XFRM
       bool
       depends on NET

config XFRM_USER
	tristate "IPsec user configuration interface"
	depends on INET && XFRM
	---help---
	  Support for IPsec user configuration interface used
	  by native Linux tools.

	  If unsure, say Y.

config NET_KEY
	tristate "PF_KEY sockets"
	select XFRM
	---help---
	  PF_KEYv2 socket family, compatible to KAME ones.
	  They are required if you are going to use IPsec tools ported
	  from KAME.

	  Say Y unless you know what you are doing.
```

## samples/Kconfig
```kconfig
FASTVC-BENCH-CORPUS:linux-main-100k-v1-e0bd41dc-8e12-4f1b-978d-a3645ae59da0
# samples/Kconfig

menuconfig SAMPLES
	bool "Sample kernel code"
	help
	  You can build and test sample kernel code here.

if SAMPLES

config SAMPLE_MARKERS
	tristate "Build markers examples -- loadable modules only"
	depends on MARKERS && m
	help
	  This build markers example modules.

endif # SAMPLES
```

## sound/parisc/Kconfig
```kconfig
FASTVC-BENCH-CORPUS:linux-main-100k-v1-e0bd41dc-8e12-4f1b-978d-a3645ae59da0
# ALSA PA-RISC drivers

menu "GSC devices"
	depends on SND!=n && GSC

config SND_HARMONY
	tristate "Harmony/Vivace sound chip"
	depends on SND
	select SND_PCM
	help
	  Say 'Y' or 'M' to include support for the Harmony/Vivace sound
	  chip found in most GSC-based PA-RISC workstations.  It's frequently
	  provided as part of the Lasi multi-function IC.

endmenu
```

## sound/pcmcia/Kconfig
```kconfig
FASTVC-BENCH-CORPUS:linux-main-100k-v1-e0bd41dc-8e12-4f1b-978d-a3645ae59da0
# ALSA PCMCIA drivers

menu "PCMCIA devices"
	depends on SND!=n && PCMCIA

config SND_VXPOCKET
	tristate "Digigram VXpocket"
	depends on SND && PCMCIA && ISA
	select SND_VX_LIB
	help
	  Say Y here to include support for Digigram VXpocket and
	  VXpocket 440 soundcards.

	  To compile this driver as a module, choose M here: the module
	  will be called snd-vxpocket.

config SND_PDAUDIOCF
	tristate "Sound Core PDAudioCF"
	depends on SND && PCMCIA && ISA
	select SND_PCM
	help
	  Say Y here to include support for Sound Core PDAudioCF
	  soundcards.

	  To compile this driver as a module, choose M here: the module
	  will be called snd-pdaudiocf.

endmenu
```

## sound/sh/Kconfig
```kconfig
FASTVC-BENCH-CORPUS:linux-main-100k-v1-e0bd41dc-8e12-4f1b-978d-a3645ae59da0
# ALSA SH drivers

menu "SUPERH devices"
	depends on SND!=n && SUPERH

config SND_AICA
	tristate "Dreamcast Yamaha AICA sound"
	depends on SH_DREAMCAST && SND
	select SND_PCM
	help
	  ALSA Sound driver for the SEGA Dreamcast console.

endmenu
```

## sound/soc/Kconfig
```kconfig
FASTVC-BENCH-CORPUS:linux-main-100k-v1-e0bd41dc-8e12-4f1b-978d-a3645ae59da0
#
# SoC audio configuration
#

menu "SoC audio support"
	depends on SND!=n

config SND_SOC
	tristate "SoC audio support"
	---help---

	  If you want SoC support, you should say Y here and also to the
	  specific driver for your SoC below. You will also need to select the
	  specific codec(s) attached to the SoC

	  This SoC audio support can also be built as a module.  If so, the module
	  will be called snd-soc-core.

endmenu
```

## sound/soc/codecs/Kconfig
```kconfig
FASTVC-BENCH-CORPUS:linux-main-100k-v1-e0bd41dc-8e12-4f1b-978d-a3645ae59da0
config SND_SOC_AC97_CODEC
	tristate
	depends on SND_SOC

config SND_SOC_WM8731
	tristate
	depends on SND_SOC

config SND_SOC_WM8750
	tristate
	depends on SND_SOC

config SND_SOC_WM9712
	tristate
	depends on SND_SOC
```

## sound/soc/s3c24xx/Kconfig
```kconfig
FASTVC-BENCH-CORPUS:linux-main-100k-v1-e0bd41dc-8e12-4f1b-978d-a3645ae59da0
menu "SoC Audio for the Samsung S3C24XX"

config SND_S3C24XX_SOC
	tristate "SoC Audio for the Samsung S3C24XX chips"
	depends on ARCH_S3C2410 && SND
	select SND_PCM
	help
	  Say Y or M if you want to add support for codecs attached to
	  the S3C24XX AC97, I2S or SSP interface. You will also need
	  to select the audio interfaces to support below.

config SND_S3C24XX_SOC_I2S
	tristate

endmenu
```

## sound/sparc/Kconfig
```kconfig
FASTVC-BENCH-CORPUS:linux-main-100k-v1-e0bd41dc-8e12-4f1b-978d-a3645ae59da0
# ALSA Sparc drivers

menu "ALSA Sparc devices"
	depends on SND!=n && (SPARC32 || SPARC64)

config SND_SUN_AMD7930
	tristate "Sun AMD7930"
	depends on SBUS && SND
	select SND_PCM

#  dep_tristate 'Sun DBRI' CONFIG_SND_SUN_DBRI $CONFIG_SND
config SND_SUN_CS4231
	tristate "Sun CS4231"
	depends on SND
	select SND_PCM

endmenu
```
