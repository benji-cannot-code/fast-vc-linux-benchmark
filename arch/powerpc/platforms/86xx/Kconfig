## arch/powerpc/platforms/86xx/Kconfig
```kconfig
FASTVC-BENCH-CORPUS:linux-main-100k-v1-e0bd41dc-8e12-4f1b-978d-a3645ae59da0
choice
	prompt "86xx Board Type"
	depends on PPC_86xx
	default MPC8641_HPCN

config MPC8641_HPCN
	bool "Freescale MPC8641 HPCN"
	select PPC_I8259
	select DEFAULT_UIMAGE
	select FSL_ULI1575
	help
	  This option enables support for the MPC8641 HPCN board.

endchoice

config MPC8641
	bool
	select FSL_PCI if PCI
	select PPC_UDBG_16550
	select MPIC
	default y if MPC8641_HPCN
```

## arch/powerpc/platforms/cell/Kconfig
```kconfig
FASTVC-BENCH-CORPUS:linux-main-100k-v1-e0bd41dc-8e12-4f1b-978d-a3645ae59da0
menu "Cell Broadband Engine options"
	depends on PPC_CELL

config SPU_FS
	tristate "SPU file system"
	default m
	depends on PPC_CELL
	help
	  The SPU file system is used to access Synergistic Processing
	  Units on machines implementing the Broadband Processor
	  Architecture.

config SPUFS_MMAP
	bool
	depends on SPU_FS && SPARSEMEM && !PPC_64K_PAGES
	default y

endmenu
```

## arch/powerpc/platforms/celleb/Kconfig
```kconfig
FASTVC-BENCH-CORPUS:linux-main-100k-v1-e0bd41dc-8e12-4f1b-978d-a3645ae59da0
config PPC_CELLEB
	bool "Toshiba's Cell Reference Set 'Celleb' Architecture"
	depends on PPC_MULTIPLATFORM && PPC64
	select PPC_CELL
	select PPC_OF_PLATFORM_PCI
	select HAS_TXX9_SERIAL
	select PPC_UDBG_BEAT
	select USB_OHCI_BIG_ENDIAN_MMIO
	select USB_EHCI_BIG_ENDIAN_MMIO
```

## arch/powerpc/platforms/iseries/Kconfig
```kconfig
FASTVC-BENCH-CORPUS:linux-main-100k-v1-e0bd41dc-8e12-4f1b-978d-a3645ae59da0

menu "iSeries device drivers"
	depends on PPC_ISERIES

config VIOCONS
	tristate "iSeries Virtual Console Support (Obsolete)"
	help
	  This is the old virtual console driver for legacy iSeries.
	  You should use the iSeries Hypervisor Virtual Console
	  support instead.

config VIODASD
	tristate "iSeries Virtual I/O disk support"
	help
	  If you are running on an iSeries system and you want to use
	  virtual disks created and managed by OS/400, say Y.

config VIOCD
	tristate "iSeries Virtual I/O CD support"
	help
	  If you are running Linux on an IBM iSeries system and you want to
	  read a CD drive owned by OS/400, say Y here.

config VIOTAPE
	tristate "iSeries Virtual Tape Support"
	help
	  If you are running Linux on an iSeries system and you want Linux
	  to read and/or write a tape drive owned by OS/400, say Y here.

endmenu

config VIOPATH
	bool
	depends on VIOCONS || VIODASD || VIOCD || VIOTAPE || VETH
	default y
```

## arch/powerpc/platforms/pasemi/Kconfig
```kconfig
FASTVC-BENCH-CORPUS:linux-main-100k-v1-e0bd41dc-8e12-4f1b-978d-a3645ae59da0
config PPC_PASEMI
	depends on PPC_MULTIPLATFORM && PPC64
	bool "PA Semi SoC-based platforms"
	default n
	select MPIC
	select PPC_UDBG_16550
	select GENERIC_TBSYNC
	select PPC_NATIVE
	help
	  This option enables support for PA Semi's PWRficient line
	  of SoC processors, including PA6T-1682M

menu "PA Semi PWRficient options"
	depends on PPC_PASEMI

config PPC_PASEMI_IOMMU
	bool "PA Semi IOMMU support"
	depends on PPC_PASEMI
	help
	  IOMMU support for PA6T-1682M

endmenu
```

## arch/powerpc/sysdev/qe_lib/Kconfig
```kconfig
FASTVC-BENCH-CORPUS:linux-main-100k-v1-e0bd41dc-8e12-4f1b-978d-a3645ae59da0
#
# QE Communication options
#

menu "QE Options"
	depends on QUICC_ENGINE

config UCC_SLOW
	bool "UCC Slow Protocols Support"
	default n
	select UCC
	help
	  This option provides qe_lib support to UCC slow
	  protocols: UART, BISYNC, QMC

config UCC_FAST
	bool "UCC Fast Protocols Support"
	default n
	select UCC
	select UCC_SLOW
	help
	  This option provides qe_lib support to UCC fast
	  protocols: HDLC, Ethernet, ATM, transparent

config UCC
	bool
	default y if UCC_FAST || UCC_SLOW

endmenu
```

## arch/s390/oprofile/Kconfig
```kconfig
FASTVC-BENCH-CORPUS:linux-main-100k-v1-e0bd41dc-8e12-4f1b-978d-a3645ae59da0

menu "Profiling support"

config PROFILING
	bool "Profiling support"
	help
	  Say Y here to enable profiling support mechanisms used by
	  profilers such as readprofile or OProfile.


config OPROFILE
	tristate "OProfile system profiling"
	depends on PROFILING
	help
	  OProfile is a profiling system capable of profiling the
	  whole system, include the kernel, kernel modules, libraries,
	  and applications.

	  If unsure, say N.

endmenu
```

## arch/sh/boards/renesas/hs7751rvoip/Kconfig
```kconfig
FASTVC-BENCH-CORPUS:linux-main-100k-v1-e0bd41dc-8e12-4f1b-978d-a3645ae59da0
if SH_HS7751RVOIP

menu "HS7751RVoIP options"

config HS7751RVOIP_CODEC
	bool "Support VoIP Codec section"
	help
	  Selecting this option will support CODEC section.

endmenu

endif
```

## arch/sh/boards/renesas/r7780rp/Kconfig
```kconfig
FASTVC-BENCH-CORPUS:linux-main-100k-v1-e0bd41dc-8e12-4f1b-978d-a3645ae59da0
if SH_R7780RP

menu "R7780RP options"

config SH_R7780MP
	bool "R7780MP board support"
	default y
	help
	  Selecting this option will enable support for the mass-production
	  version of the R7780RP. If in doubt, say Y.

endmenu

endif
```

## arch/sh/boards/renesas/rts7751r2d/Kconfig
```kconfig
FASTVC-BENCH-CORPUS:linux-main-100k-v1-e0bd41dc-8e12-4f1b-978d-a3645ae59da0
if SH_RTS7751R2D

menu "RTS7751R2D options"

config RTS7751R2D_REV11
	bool "RTS7751R2D Rev. 1.1 board support"
	help
	  Selecting this option will support version rev. 1.1.
endmenu

endif
```

## arch/sh/drivers/Kconfig
```kconfig
FASTVC-BENCH-CORPUS:linux-main-100k-v1-e0bd41dc-8e12-4f1b-978d-a3645ae59da0
menu "Additional SuperH Device Drivers"

config PUSH_SWITCH
	tristate "Push switch support"
	help
	  This enables support for the push switch framework, a simple
	  framework that allows for sysfs driven switch status reporting.

endmenu
```

## arch/v850/Kconfig.debug
```kconfig
FASTVC-BENCH-CORPUS:linux-main-100k-v1-e0bd41dc-8e12-4f1b-978d-a3645ae59da0
menu "Kernel hacking"

source "lib/Kconfig.debug"

config NO_KERNEL_MSG
	bool "Suppress Kernel BUG Messages"
	help
	  Do not output any debug BUG messages within the kernel.

endmenu
```

## arch/x86/Kconfig.i386
```kconfig
FASTVC-BENCH-CORPUS:linux-main-100k-v1-e0bd41dc-8e12-4f1b-978d-a3645ae59da0
#
# For a description of the syntax of this configuration file,
# see Documentation/kbuild/kconfig-language.txt.
#

mainmenu "Linux Kernel Configuration"

config X86_32
	bool
	default y
	help
	  This is Linux's home port.  Linux was originally native to the Intel
	  386, and runs on all the later x86 processors including the Intel
	  486, 586, Pentiums, and various instruction-set-compatible chips by
	  AMD, Cyrix, and others.


source "arch/x86/Kconfig"
```

## arch/x86/oprofile/Kconfig
```kconfig
FASTVC-BENCH-CORPUS:linux-main-100k-v1-e0bd41dc-8e12-4f1b-978d-a3645ae59da0
config PROFILING
	bool "Profiling support (EXPERIMENTAL)"
	help
	  Say Y here to enable the extended profiling support mechanisms used
	  by profilers such as OProfile.
	  

config OPROFILE
	tristate "OProfile system profiling (EXPERIMENTAL)"
	depends on PROFILING
	help
	  OProfile is a profiling system capable of profiling the
	  whole system, include the kernel, kernel modules, libraries,
	  and applications.

	  If unsure, say N.
```

## arch/x86/xen/Kconfig
```kconfig
FASTVC-BENCH-CORPUS:linux-main-100k-v1-e0bd41dc-8e12-4f1b-978d-a3645ae59da0
#
# This Kconfig describes xen options
#

config XEN
	bool "Xen guest support"
	select PARAVIRT
	depends on X86_CMPXCHG && X86_TSC && !NEED_MULTIPLE_NODES && !(X86_VISWS || X86_VOYAGER)
	help
	  This is the Linux Xen port.  Enabling this will allow the
	  kernel to boot in a paravirtualized environment under the
	  Xen hypervisor.
```

## drivers/char/pcmcia/Kconfig
```kconfig
FASTVC-BENCH-CORPUS:linux-main-100k-v1-e0bd41dc-8e12-4f1b-978d-a3645ae59da0
#
# PCMCIA character device configuration
#

menu "PCMCIA character devices"
	depends on HOTPLUG && PCMCIA!=n

config SYNCLINK_CS
	tristate "SyncLink PC Card support"
	depends on PCMCIA
	help
	  Enable support for the SyncLink PC Card serial adapter, running
	  asynchronous and HDLC communications up to 512Kbps. The port is
	  selectable for RS-232, V.35, RS-449, RS-530, and X.21

	  This driver may be built as a module ( = code which can be
	  inserted in and removed from the running kernel whenever you want).
	  The module will be called synclinkmp.  If you want to do that, say M
	  here.

endmenu
```

## drivers/connector/Kconfig
```kconfig
FASTVC-BENCH-CORPUS:linux-main-100k-v1-e0bd41dc-8e12-4f1b-978d-a3645ae59da0
menu "Connector - unified userspace <-> kernelspace linker"

config CONNECTOR
	tristate "Connector - unified userspace <-> kernelspace linker"
	depends on NET
	---help---
	  This is unified userspace <-> kernelspace connector working on top
	  of the netlink socket protocol.

	  Connector support can also be built as a module.  If so, the module
	  will be called cn.ko.

endmenu
```

## drivers/dca/Kconfig
```kconfig
FASTVC-BENCH-CORPUS:linux-main-100k-v1-e0bd41dc-8e12-4f1b-978d-a3645ae59da0
#
# DCA server configuration
#

config DCA
	tristate "DCA support for clients and providers"
	default m
	help
	  This is a server to help modules that want to use Direct Cache
	  Access to find DCA providers that will supply correct CPU tags.
```

## drivers/dma/Kconfig
```kconfig
FASTVC-BENCH-CORPUS:linux-main-100k-v1-e0bd41dc-8e12-4f1b-978d-a3645ae59da0
#
# DMA engine configuration
#

menu "DMA Engine support"

config DMA_ENGINE
	bool "Support for DMA engines"
	---help---
	  DMA engines offload copy operations from the CPU to dedicated
	  hardware, allowing the copies to happen asynchronously.

endmenu
```

## drivers/hid/Kconfig
```kconfig
FASTVC-BENCH-CORPUS:linux-main-100k-v1-e0bd41dc-8e12-4f1b-978d-a3645ae59da0
#
# HID driver configuration
#
menu "HID Devices"
	depends on INPUT

config HID
	tristate "Generic HID support"
	depends on INPUT
	default y
	---help---
	  Say Y here if you want generic HID support to connect keyboards,
	  mice, joysticks, graphic tablets, or any other HID based devices
	  to your computer. You also need to select particular types of
	  HID devices you want to compile support for, in the particular
	  driver menu (USB, Bluetooth)

endmenu
```

## drivers/i2c/algos/Kconfig
```kconfig
FASTVC-BENCH-CORPUS:linux-main-100k-v1-e0bd41dc-8e12-4f1b-978d-a3645ae59da0
#
# I2C algorithm drivers configuration
#

config I2C_ALGOBIT
	tristate

config I2C_ALGOPCF
	tristate

config I2C_ALGOPCA
	tristate

config I2C_ALGO_SGI
	tristate
	depends on SGI_IP22 || SGI_IP32 || X86_VISWS
```

## drivers/infiniband/Kconfig
```kconfig
FASTVC-BENCH-CORPUS:linux-main-100k-v1-e0bd41dc-8e12-4f1b-978d-a3645ae59da0
menu "InfiniBand support"

config INFINIBAND
	tristate "InfiniBand support"
	---help---
	  Core support for InfiniBand (IB).  Make sure to also select
	  any protocols you wish to use as well as drivers for your
	  InfiniBand hardware.

source "drivers/infiniband/hw/mthca/Kconfig"

source "drivers/infiniband/ulp/ipoib/Kconfig"

endmenu
```

## drivers/infiniband/hw/ehca/Kconfig
```kconfig
FASTVC-BENCH-CORPUS:linux-main-100k-v1-e0bd41dc-8e12-4f1b-978d-a3645ae59da0
config INFINIBAND_EHCA
	tristate "eHCA support"
	depends on IBMEBUS && INFINIBAND
	---help---
	This driver supports the IBM pSeries eHCA InfiniBand adapter.

	To compile the driver as a module, choose M here. The module
	will be called ib_ehca.

config INFINIBAND_EHCA_SCALING
	bool "Scaling support (EXPERIMENTAL)"
	depends on IBMEBUS && INFINIBAND_EHCA && HOTPLUG_CPU && EXPERIMENTAL
	default y
	---help---
	eHCA scaling support schedules the CQ callbacks to different CPUs.

	To enable this feature choose Y here.
```

## drivers/infiniband/hw/ipath/Kconfig
```kconfig
FASTVC-BENCH-CORPUS:linux-main-100k-v1-e0bd41dc-8e12-4f1b-978d-a3645ae59da0
config INFINIBAND_IPATH
	tristate "QLogic InfiniPath Driver"
	depends on (PCI_MSI || HT_IRQ) && 64BIT && INFINIBAND && NET
	---help---
	This is a driver for QLogic InfiniPath host channel adapters,
	including InfiniBand verbs support.  This driver allows these
	devices to be used with both kernel upper level protocols such
	as IP-over-InfiniBand as well as with userspace applications
	(in conjunction with InfiniBand userspace access).
```
