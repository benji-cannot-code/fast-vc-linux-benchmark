## arch/arm/common/Kconfig
```kconfig
FASTVC-BENCH-CORPUS:linux-main-100k-v1-e0bd41dc-8e12-4f1b-978d-a3645ae59da0
config ICST525
	bool

config ARM_GIC
	bool

config ICST307
	bool

config SA1111
	bool
	select DMABOUNCE

config DMABOUNCE
	bool

config TIMER_ACORN
	bool

config SHARP_LOCOMO
	bool

config SHARP_PARAM
	bool

config SHARPSL_PM
	bool

config SHARP_SCOOP
	bool
```

## arch/arm/mach-aaec2000/Kconfig
```kconfig
FASTVC-BENCH-CORPUS:linux-main-100k-v1-e0bd41dc-8e12-4f1b-978d-a3645ae59da0
if ARCH_AAEC2000

menu "Agilent AAEC-2000 Implementations"

config MACH_AAED2000
	bool "Agilent AAED-2000 Development Platform"
	select CPU_ARM920T

endmenu

endif
```

## arch/arm/mach-davinci/Kconfig
```kconfig
FASTVC-BENCH-CORPUS:linux-main-100k-v1-e0bd41dc-8e12-4f1b-978d-a3645ae59da0
if ARCH_DAVINCI

menu "TI DaVinci Implementations"

comment "DaVinci Core Type"

config ARCH_DAVINCI644x
	default y
	bool "DaVinci 644x based system"

comment "DaVinci Board Type"

config MACH_DAVINCI_EVM
	bool "TI DaVinci EVM"
	default y
	depends on ARCH_DAVINCI644x
	help
	  Configure this option to specify the whether the board used
	  for development is a DaVinci EVM

endmenu

endif
```

## arch/arm/mach-imx/Kconfig
```kconfig
FASTVC-BENCH-CORPUS:linux-main-100k-v1-e0bd41dc-8e12-4f1b-978d-a3645ae59da0
menu "IMX Implementations"
	depends on ARCH_IMX

config ARCH_MX1ADS
	bool "mx1ads"
	depends on ARCH_IMX
	select ISA
	help
	  Say Y here if you are using the Motorola MX1ADS board

endmenu
```

## arch/arm/mach-ixp23xx/Kconfig
```kconfig
FASTVC-BENCH-CORPUS:linux-main-100k-v1-e0bd41dc-8e12-4f1b-978d-a3645ae59da0
if ARCH_IXP23XX

config ARCH_SUPPORTS_BIG_ENDIAN
	bool
	default y

menu "Intel IXP23xx Implementation Options"

comment "IXP23xx Platforms"

config MACH_ESPRESSO
	bool "Support IP Fabrics Double Espresso platform"
	help

config MACH_IXDP2351
	bool "Support Intel IXDP2351 platform"
	help

config MACH_ROADRUNNER
	bool "Support ADI RoadRunner platform"
	help

endmenu

endif
```

## arch/arm/mach-netx/Kconfig
```kconfig
FASTVC-BENCH-CORPUS:linux-main-100k-v1-e0bd41dc-8e12-4f1b-978d-a3645ae59da0
menu "NetX Implementations"
	depends on ARCH_NETX

config MACH_NXDKN
	bool "Enable Hilscher nxdkn Eval Board support"
	depends on ARCH_NETX
	help
	  Board support for the Hilscher NetX Eval Board

endmenu
```

## arch/arm/mach-orion/Kconfig
```kconfig
FASTVC-BENCH-CORPUS:linux-main-100k-v1-e0bd41dc-8e12-4f1b-978d-a3645ae59da0
if ARCH_ORION

menu "Orion Implementations"

config MACH_DB88F5281
	bool "Marvell Orion-2 Development Board"
	select I2C_BOARDINFO
	help
	  Say 'Y' here if you want your kernel to support the
	  Marvell Orion-2 (88F5281) Development Board

config MACH_RD88F5182
	bool "Marvell Orion-NAS Reference Design"
	select I2C_BOARDINFO
	help
	  Say 'Y' here if you want your kernel to support the
	  Marvell Orion-NAS (88F5182) RD2

config MACH_KUROBOX_PRO
	bool "KuroBox Pro"
	select I2C_BOARDINFO
	help
	  Say 'Y' here if you want your kernel to support the
	  KuroBox Pro platform.

config MACH_DNS323
	bool "D-Link DNS-323"
	select I2C_BOARDINFO
	help
	  Say 'Y' here if you want your kernel to support the
	  D-Link DNS-323 platform.

endmenu

endif
```

## arch/arm/mach-realview/Kconfig
```kconfig
FASTVC-BENCH-CORPUS:linux-main-100k-v1-e0bd41dc-8e12-4f1b-978d-a3645ae59da0
menu "RealView platform type"
	depends on ARCH_REALVIEW

config MACH_REALVIEW_EB
	bool "Support RealView/EB platform"
	default n
	select ARM_GIC
	help
	  Include support for the ARM(R) RealView Emulation Baseboard platform.

config REALVIEW_MPCORE
	bool "Support MPcore tile"
	depends on MACH_REALVIEW_EB
	help
	  Enable support for the MPCore tile on the Realview platform.
	  Since there are device address and interrupt differences, a
	  kernel built with this option enabled is not compatible with
	  other tiles.

endmenu
```

## arch/arm/oprofile/Kconfig
```kconfig
FASTVC-BENCH-CORPUS:linux-main-100k-v1-e0bd41dc-8e12-4f1b-978d-a3645ae59da0

menu "Profiling support"
	depends on EXPERIMENTAL

config PROFILING
	bool "Profiling support (EXPERIMENTAL)"
	help
	  Say Y here to enable the extended profiling support mechanisms used
	  by profilers such as OProfile.


config OPROFILE
	tristate "OProfile system profiling (EXPERIMENTAL)"
	depends on PROFILING
	help
	  OProfile is a profiling system capable of profiling the
	  whole system, include the kernel, kernel modules, libraries,
	  and applications.

	  If unsure, say N.

if OPROFILE

config OPROFILE_ARMV6
	bool
	depends on CPU_V6 && !SMP
	default y
	select OPROFILE_ARM11_CORE

config OPROFILE_ARM11_CORE
	bool

endif

endmenu
```

## arch/arm/plat-mxc/Kconfig
```kconfig
FASTVC-BENCH-CORPUS:linux-main-100k-v1-e0bd41dc-8e12-4f1b-978d-a3645ae59da0
if ARCH_MXC

menu "Freescale MXC Implementations"

choice
	prompt "MXC/iMX System Type"
	default 0

config ARCH_MX3
	bool "MX3-based"
	help
	  This enables support for systems based on the Freescale i.MX3 family

endchoice

source "arch/arm/mach-mx3/Kconfig"

endmenu

endif
```

## arch/avr32/Kconfig.debug
```kconfig
FASTVC-BENCH-CORPUS:linux-main-100k-v1-e0bd41dc-8e12-4f1b-978d-a3645ae59da0
menu "Kernel hacking"

config TRACE_IRQFLAGS_SUPPORT
	bool
	default y

source "lib/Kconfig.debug"

config KPROBES
	bool "Kprobes"
	depends on DEBUG_KERNEL
	help
	  Kprobes allows you to trap at almost any kernel address and
          execute a callback function.  register_kprobe() establishes
          a probepoint and specifies the callback.  Kprobes is useful
          for kernel debugging, non-intrusive instrumentation and testing.
          If in doubt, say "N".

endmenu
```

## arch/avr32/mach-at32ap/Kconfig
```kconfig
FASTVC-BENCH-CORPUS:linux-main-100k-v1-e0bd41dc-8e12-4f1b-978d-a3645ae59da0
if PLATFORM_AT32AP

menu "Atmel AVR32 AP options"

endmenu

endif
```

## arch/blackfin/oprofile/Kconfig
```kconfig
FASTVC-BENCH-CORPUS:linux-main-100k-v1-e0bd41dc-8e12-4f1b-978d-a3645ae59da0
menu "Profiling support"
depends on EXPERIMENTAL

config PROFILING
	bool "Profiling support (EXPERIMENTAL)"
	help
	  Say Y here to enable the extended profiling support mechanisms used
	  by profilers such as OProfile.

config OPROFILE
	tristate "OProfile system profiling (EXPERIMENTAL)"
	depends on PROFILING
	help
	  OProfile is a profiling system capable of profiling the
	  whole system, include the kernel, kernel modules, libraries,
	  and applications.

	  If unsure, say N.

config HARDWARE_PM
	tristate "Hardware Performance Monitor Profiling"
	depends on PROFILING
	help
	  take use of hardware performance monitor to profiling the kernel
	  and application.

	  If unsure, say N.

endmenu
```

## arch/i386/xen/Kconfig
```kconfig
FASTVC-BENCH-CORPUS:linux-main-100k-v1-e0bd41dc-8e12-4f1b-978d-a3645ae59da0
#
# This Kconfig describes xen options
#

config XEN
	bool "Enable support for Xen hypervisor"
	depends on PARAVIRT && X86_CMPXCHG && X86_TSC && !(PREEMPT || SMP || NEED_MULTIPLE_NODES)
	help
	  This is the Linux Xen port.  Enabling this will allow the
	  kernel to boot in a paravirtualized environment under the
	  Xen hypervisor.
```

## arch/mips/basler/excite/Kconfig
```kconfig
FASTVC-BENCH-CORPUS:linux-main-100k-v1-e0bd41dc-8e12-4f1b-978d-a3645ae59da0
config BASLER_EXCITE_PROTOTYPE
	bool "Support for pre-release units"
	depends on BASLER_EXCITE
	default n
	help
	  Pre-series (prototype) units are different from later ones in
	  some ways. Select this option if you have one of these. Please
	  note that a kernel built with this option selected will not be
	  able to run on normal units.
```

## arch/mips/cobalt/Kconfig
```kconfig
FASTVC-BENCH-CORPUS:linux-main-100k-v1-e0bd41dc-8e12-4f1b-978d-a3645ae59da0
config EARLY_PRINTK
	bool "Early console support"
	depends on MIPS_COBALT
	help
	  Provide early console support by direct access to the
	  on board UART. The UART must have been previously
	  initialised by the boot loader.
```

## arch/mips/ddb5xxx/Kconfig
```kconfig
FASTVC-BENCH-CORPUS:linux-main-100k-v1-e0bd41dc-8e12-4f1b-978d-a3645ae59da0
config DDB5477_BUS_FREQUENCY
	int "bus frequency (in kHZ, 0 for auto-detect)"
	depends on DDB5477
	default 0
```

## arch/mips/gt64120/ev64120/Kconfig
```kconfig
FASTVC-BENCH-CORPUS:linux-main-100k-v1-e0bd41dc-8e12-4f1b-978d-a3645ae59da0
config EVB_PCI1
	bool "Enable Second PCI (PCI1)"
	depends on MIPS_EV64120
```

## arch/mips/ite-boards/Kconfig
```kconfig
FASTVC-BENCH-CORPUS:linux-main-100k-v1-e0bd41dc-8e12-4f1b-978d-a3645ae59da0
config IT8172_REVC
	bool "Support for older IT8172 (Rev C)"
	depends on MIPS_ITE8172
	help
	  Say Y here to support the older, Revision C version of the Integrated
	  Technology Express, Inc. ITE8172 SBC.  Vendor page at
	  <http://www.ite.com.tw/ia/brief_it8172bsp.htm>; picture of the
	  board at <http://www.mvista.com/partners/semiconductor/ite.html>.
```

## arch/mips/momentum/Kconfig
```kconfig
FASTVC-BENCH-CORPUS:linux-main-100k-v1-e0bd41dc-8e12-4f1b-978d-a3645ae59da0
config JAGUAR_DMALOW
	bool "Low DMA Mode"
	depends on MOMENCO_JAGUAR_ATX
	help
	  Select to Y if jump JP5 is set on your board, N otherwise.  Normally
	  the jumper is set, so if you feel unsafe, just say Y.
```

## arch/mips/pmc-sierra/Kconfig
```kconfig
FASTVC-BENCH-CORPUS:linux-main-100k-v1-e0bd41dc-8e12-4f1b-978d-a3645ae59da0
config HYPERTRANSPORT
	bool "Hypertransport Support for PMC-Sierra Yosemite"
	depends on PMC_YOSEMITE
```

## arch/mips/tx4927/Kconfig
```kconfig
FASTVC-BENCH-CORPUS:linux-main-100k-v1-e0bd41dc-8e12-4f1b-978d-a3645ae59da0
config TOSHIBA_FPCIB0
	bool "FPCIB0 Backplane Support"
	depends on TOSHIBA_RBTX4927
```

## arch/parisc/Kconfig.debug
```kconfig
FASTVC-BENCH-CORPUS:linux-main-100k-v1-e0bd41dc-8e12-4f1b-978d-a3645ae59da0
menu "Kernel hacking"

source "lib/Kconfig.debug"

config DEBUG_RWLOCK
        bool "Read-write spinlock debugging"
        depends on DEBUG_KERNEL && SMP
        help
          If you say Y here then read-write lock processing will count how many
          times it has tried to get the lock and issue an error message after
          too many attempts.  If you suspect a rwlock problem or a kernel
          hacker asks for this option then say Y.  Otherwise say N.

endmenu
```

## arch/powerpc/platforms/82xx/Kconfig
```kconfig
FASTVC-BENCH-CORPUS:linux-main-100k-v1-e0bd41dc-8e12-4f1b-978d-a3645ae59da0
menu "Platform support"
       depends on PPC_82xx

choice
       prompt "Machine Type"
       default MPC82xx_ADS

config MPC82xx_ADS
       bool "Freescale MPC82xx ADS"
       select DEFAULT_UIMAGE
       select PQ2ADS
       select 8272
       select 8260
       select CPM2
       select FSL_SOC
       help
         This option enables support for the MPC8272 ADS board

endchoice

endmenu
```

## arch/powerpc/platforms/85xx/Kconfig
```kconfig
FASTVC-BENCH-CORPUS:linux-main-100k-v1-e0bd41dc-8e12-4f1b-978d-a3645ae59da0
menu "Platform support"
	depends on PPC_85xx

choice
	prompt "Machine Type"
	default MPC8540_ADS

config MPC8540_ADS
	bool "Freescale MPC8540 ADS"
	select DEFAULT_UIMAGE
	help
	  This option enables support for the MPC 8540 ADS board

endchoice

config MPC8540
	bool
	select PPC_UDBG_16550
	select PPC_INDIRECT_PCI
	default y if MPC8540_ADS

config PPC_INDIRECT_PCI_BE
	bool
	depends on PPC_85xx
	default y

config MPIC
	bool
	default y

endmenu
```
