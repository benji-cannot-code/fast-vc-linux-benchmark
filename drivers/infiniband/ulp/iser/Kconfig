## drivers/infiniband/ulp/iser/Kconfig
```kconfig
FASTVC-BENCH-CORPUS:linux-main-100k-v1-e0bd41dc-8e12-4f1b-978d-a3645ae59da0
config INFINIBAND_ISER
	tristate "ISCSI RDMA Protocol"
	depends on INFINIBAND && SCSI
	select SCSI_ISCSI_ATTRS
	---help---
	  Support for the ISCSI RDMA Protocol over InfiniBand.  This
	  allows you to access storage devices that speak ISER/ISCSI
	  over InfiniBand.

	  The ISER protocol is defined by IETF.
	  See <http://www.ietf.org/>.
```

## drivers/kvm/Kconfig
```kconfig
FASTVC-BENCH-CORPUS:linux-main-100k-v1-e0bd41dc-8e12-4f1b-978d-a3645ae59da0
#
# KVM configuration
#
menu "Virtualization"

config KVM
	tristate "Kernel-based Virtual Machine (KVM) support"
	depends on X86 && EXPERIMENTAL
	---help---
	  Support hosting fully virtualized guest machines using hardware
	  virtualization extensions.  You will need a fairly recent
	  processor equipped with virtualization extensions. You will also
	  need to select one or more of the processor modules below.

	  This module provides access to the hardware capabilities through
	  a character device node named /dev/kvm.

	  To compile this as a module, choose M here: the module
	  will be called kvm.

	  If unsure, say N.

config KVM_INTEL
	tristate "KVM for Intel processors support"
	depends on KVM
	---help---
	  Provides support for KVM on Intel processors equipped with the VT
	  extensions.

config KVM_AMD
	tristate "KVM for AMD processors support"
	depends on KVM
	---help---
	  Provides support for KVM on AMD processors equipped with the AMD-V
	  (SVM) extensions.

endmenu
```

## drivers/media/common/Kconfig
```kconfig
FASTVC-BENCH-CORPUS:linux-main-100k-v1-e0bd41dc-8e12-4f1b-978d-a3645ae59da0
config VIDEO_SAA7146
	tristate
	select I2C

config VIDEO_SAA7146_VV
	tristate
	select VIDEO_BUF
	select VIDEO_VIDEOBUF
	select VIDEO_SAA7146

config VIDEO_VIDEOBUF
	tristate
```

## drivers/media/dvb/dvb-core/Kconfig
```kconfig
FASTVC-BENCH-CORPUS:linux-main-100k-v1-e0bd41dc-8e12-4f1b-978d-a3645ae59da0
config DVB_CORE
	tristate "DVB Core Support"
	depends on DVB
	select CRC32
	help
	  DVB core utility functions for device handling, software fallbacks etc.
	  Say Y when you have a DVB card and want to use it. Say Y if your want
	  to build your drivers outside the kernel, but need the DVB core. All
	  in-kernel drivers will select this automatically if needed.
	  If unsure say N.
```

## drivers/media/video/em28xx/Kconfig
```kconfig
FASTVC-BENCH-CORPUS:linux-main-100k-v1-e0bd41dc-8e12-4f1b-978d-a3645ae59da0
config VIDEO_EM28XX
	tristate "Empia EM2800/2820/2840 USB video capture support"
	depends on VIDEO_DEV && I2C && INPUT
	select VIDEO_TUNER
	select VIDEO_TVEEPROM
	select VIDEO_IR
	select VIDEO_SAA711X if VIDEO_HELPER_CHIPS_AUTO
	select VIDEO_TVP5150 if VIDEO_HELPER_CHIPS_AUTO
	---help---
	  This is a video4linux driver for Empia 28xx based TV cards.

	  To compile this driver as a module, choose M here: the
	  module will be called em28xx
```

## drivers/media/video/zc0301/Kconfig
```kconfig
FASTVC-BENCH-CORPUS:linux-main-100k-v1-e0bd41dc-8e12-4f1b-978d-a3645ae59da0
config USB_ZC0301
	tristate "USB ZC0301[P] Image Processor and Control Chip support"
	depends on USB && VIDEO_V4L1
	---help---
	  Say Y here if you want support for cameras based on the ZC0301 or
	  ZC0301P Image Processors and Control Chips.

	  See <file:Documentation/video4linux/zc0301.txt> for more info.

	  To compile this driver as a module, choose M here: the
	  module will be called zc0301.
```

## drivers/mfd/Kconfig
```kconfig
FASTVC-BENCH-CORPUS:linux-main-100k-v1-e0bd41dc-8e12-4f1b-978d-a3645ae59da0
#
# Multifunction miscellaneous devices
#

menu "Multimedia Capabilities Port drivers"

config MCP
	tristate

# Interface drivers
config MCP_SA11X0
	tristate "Support SA11x0 MCP interface"
	depends on ARCH_SA1100
	select MCP

endmenu
```

## drivers/mmc/Kconfig
```kconfig
FASTVC-BENCH-CORPUS:linux-main-100k-v1-e0bd41dc-8e12-4f1b-978d-a3645ae59da0
#
# MMC subsystem configuration
#

menu "MMC/SD Card support"

config MMC
	tristate "MMC support"
	help
	  MMC is the "multi-media card" bus protocol.

	  If you want MMC support, you should say Y here and also
	  to the specific driver for your MMC interface.

config MMC_DEBUG
	bool "MMC debugging"
	depends on MMC != n
	help
	  This is an option for use by developers; most people should
	  say N here.  This enables MMC core and driver debugging.

source "drivers/mmc/core/Kconfig"

source "drivers/mmc/card/Kconfig"

source "drivers/mmc/host/Kconfig"

endmenu
```

## drivers/mmc/card/Kconfig
```kconfig
FASTVC-BENCH-CORPUS:linux-main-100k-v1-e0bd41dc-8e12-4f1b-978d-a3645ae59da0
#
# MMC/SD card drivers
#

comment "MMC/SD Card Drivers"
	depends MMC

config MMC_BLOCK
	tristate "MMC block device driver"
	depends on MMC && BLOCK
	default y
	help
	  Say Y here to enable the MMC block device driver support.
	  This provides a block device driver, which you can use to
	  mount the filesystem. Almost everyone wishing MMC support
	  should say Y or M here.
```

## drivers/net/fec_8xx/Kconfig
```kconfig
FASTVC-BENCH-CORPUS:linux-main-100k-v1-e0bd41dc-8e12-4f1b-978d-a3645ae59da0
config FEC_8XX
	tristate "Motorola 8xx FEC driver"
	depends on NET_ETHERNET && 8xx
	select MII

config FEC_8XX_GENERIC_PHY
	bool "Support any generic PHY"
	depends on FEC_8XX
	default y

config FEC_8XX_DM9161_PHY
	bool "Support DM9161 PHY"
	depends on FEC_8XX
	default n

config FEC_8XX_LXT971_PHY
	bool "Support LXT971/LXT972 PHY"
	depends on FEC_8XX
	default n
```

## drivers/net/fs_enet/Kconfig
```kconfig
FASTVC-BENCH-CORPUS:linux-main-100k-v1-e0bd41dc-8e12-4f1b-978d-a3645ae59da0
config FS_ENET
       tristate "Freescale Ethernet Driver"
       depends on NET_ETHERNET && (CPM1 || CPM2)
       select MII

config FS_ENET_HAS_SCC
	bool "Chip has an SCC usable for ethernet"
	depends on FS_ENET && (CPM1 || CPM2)
	default y

config FS_ENET_HAS_FCC
	bool "Chip has an FCC usable for ethernet"
	depends on FS_ENET && CPM2
	default y

config FS_ENET_HAS_FEC
	bool "Chip has an FEC usable for ethernet"
	depends on FS_ENET && CPM1
	default y
```

## drivers/pci/pcie/Kconfig
```kconfig
FASTVC-BENCH-CORPUS:linux-main-100k-v1-e0bd41dc-8e12-4f1b-978d-a3645ae59da0
#
# PCI Express Port Bus Configuration
#
config PCIEPORTBUS
	bool "PCI Express support"
	depends on PCI
	help
	  This automatically enables PCI Express Port Bus support. Users can
	  choose Native Hot-Plug support, Advanced Error Reporting support,
	  Power Management Event support and Virtual Channel support to run
	  on PCI Express Ports (Root or Switch).

#
# Include service Kconfig here
#
config HOTPLUG_PCI_PCIE
	tristate "PCI Express Hotplug driver"
	depends on HOTPLUG_PCI && PCIEPORTBUS
	help
	  Say Y here if you have a motherboard that supports PCI Express Native
	  Hotplug

	  To compile this driver as a module, choose M here: the
	  module will be called pciehp.

	  When in doubt, say N.

source "drivers/pci/pcie/aer/Kconfig"
```

## drivers/pci/pcie/aer/Kconfig
```kconfig
FASTVC-BENCH-CORPUS:linux-main-100k-v1-e0bd41dc-8e12-4f1b-978d-a3645ae59da0
#
# PCI Express Root Port Device AER Configuration
#

config PCIEAER
	boolean "Root Port Advanced Error Reporting support"
	depends on PCIEPORTBUS && ACPI
	default y
	help
	  This enables PCI Express Root Port Advanced Error Reporting
	  (AER) driver support. Error reporting messages sent to Root
	  Port will be handled by PCI Express AER driver.
```

## drivers/usb/misc/sisusbvga/Kconfig
```kconfig
FASTVC-BENCH-CORPUS:linux-main-100k-v1-e0bd41dc-8e12-4f1b-978d-a3645ae59da0

config USB_SISUSBVGA
	tristate "USB 2.0 SVGA dongle support (Net2280/SiS315)"
	depends on USB && USB_EHCI_HCD
        ---help---
	  Say Y here if you intend to attach a USB2VGA dongle based on a
	  Net2280 and a SiS315 chip. 
	  
	  Note that this device requires a USB 2.0 host controller. It will not 
	  work with USB 1.x controllers.

	  To compile this driver as a module, choose M here: the module will be
	  called sisusb.  If unsure, say N.
```

## drivers/usb/mon/Kconfig
```kconfig
FASTVC-BENCH-CORPUS:linux-main-100k-v1-e0bd41dc-8e12-4f1b-978d-a3645ae59da0
#
# USB Monitor configuration
#

config USB_MON
	bool "USB Monitor"
	depends on USB!=n
	default y
	help
	  If you say Y here, a component which captures the USB traffic
	  between peripheral-specific drivers and HC drivers will be built.
	  The USB_MON is similar in spirit and may be compatible with Dave
	  Harding's USBMon.

	  This is somewhat experimental at this time, but it should be safe,
	  as long as you aren't using modular USB and try to remove this
	  module.
```

## kernel/Kconfig.preempt
```kconfig
FASTVC-BENCH-CORPUS:linux-main-100k-v1-e0bd41dc-8e12-4f1b-978d-a3645ae59da0

config PREEMPT
	bool "Preemptible Kernel"
	help
	  This option reduces the latency of the kernel when reacting to
	  real-time or interactive events by allowing a low priority process to
	  be preempted even if it is in kernel mode executing a system call.
	  This allows applications to run more reliably even when the system is
	  under load.

	  Say Y here if you are building a kernel for a desktop, embedded
	  or real-time system.  Say N if you are unsure.

config PREEMPT_BKL
	bool "Preempt The Big Kernel Lock"
	depends on SMP || PREEMPT
	default y
	help
	  This option reduces the latency of the kernel by making the
	  big kernel lock preemptible.

	  Say Y here if you are building a kernel for a desktop system.
	  Say N if you are unsure.
```

## kernel/time/Kconfig
```kconfig
FASTVC-BENCH-CORPUS:linux-main-100k-v1-e0bd41dc-8e12-4f1b-978d-a3645ae59da0
#
# Timer subsystem related configuration options
#
config TICK_ONESHOT
	bool
	default n

config NO_HZ
	bool "Tickless System (Dynamic Ticks)"
	depends on GENERIC_TIME && GENERIC_CLOCKEVENTS
	select TICK_ONESHOT
	help
	  This option enables a tickless system: timer interrupts will
	  only trigger on an as-needed basis both when the system is
	  busy and when the system is idle.
```

## mm/Kconfig
```kconfig
FASTVC-BENCH-CORPUS:linux-main-100k-v1-e0bd41dc-8e12-4f1b-978d-a3645ae59da0
choice
	prompt "Memory model"
	default DISCONTIGMEM if ARCH_DISCONTIGMEM_DEFAULT
	default FLATMEM

config FLATMEM
	bool "Flat Memory"
	depends on !ARCH_DISCONTIGMEM_ENABLE || ARCH_FLATMEM_ENABLE
	help
	  This option allows you to change some of the ways that
	  Linux manages its memory internally.  Most users will
	  only have one option here: FLATMEM.  This is normal
	  and a correct option.

	  If unsure, choose this option over any other.

config DISCONTIGMEM
	bool "Discontigious Memory"
	depends on ARCH_DISCONTIGMEM_ENABLE
	help
	  If unsure, choose "Flat Memory" over this option.

endchoice

#
# Both the NUMA code and DISCONTIGMEM use arrays of pg_data_t's
# to represent different areas of memory.  This variable allows
# those dependencies to exist individually.
#
config NEED_MULTIPLE_NODES
	def_bool y
	depends on DISCONTIGMEM || NUMA
```

## net/9p/Kconfig
```kconfig
FASTVC-BENCH-CORPUS:linux-main-100k-v1-e0bd41dc-8e12-4f1b-978d-a3645ae59da0
#
# 9P protocol configuration
#

menuconfig NET_9P
	depends on NET && EXPERIMENTAL
	tristate "Plan 9 Resource Sharing Support (9P2000) (Experimental)"
	help
	  If you say Y here, you will get experimental support for
	  Plan 9 resource sharing via the 9P2000 protocol.

	  See <http://v9fs.sf.net> for more information.

	  If unsure, say N.

config NET_9P_FD
	depends on NET_9P
	default y if NET_9P
	tristate "9P File Descriptor Transports (Experimental)"
	help
	  This builds support for file descriptor transports for 9p
	  which includes support for TCP/IP, named pipes, or passed
	  file descriptors.  TCP/IP is the default transport for 9p,
	  so if you are going to use 9p, you'll likely want this.

config NET_9P_DEBUG
	bool "Debug information"
	depends on NET_9P
	help
	  Say Y if you want the 9P subsystem to log debug information.
```

## net/can/Kconfig
```kconfig
FASTVC-BENCH-CORPUS:linux-main-100k-v1-e0bd41dc-8e12-4f1b-978d-a3645ae59da0
#
# Controller Area Network (CAN) network layer core configuration
#

menuconfig CAN
	depends on NET
	tristate "CAN bus subsystem support"
	---help---
	  Controller Area Network (CAN) is a slow (up to 1Mbit/s) serial
	  communications protocol which was developed by Bosch in
	  1991, mainly for automotive, but now widely used in marine
	  (NMEA2000), industrial, and medical applications.
	  More information on the CAN network protocol family PF_CAN
	  is contained in <Documentation/networking/can.txt>.

	  If you want CAN support you should say Y here and also to the
	  specific driver for your controller(s) below.
```

## net/ieee80211/softmac/Kconfig
```kconfig
FASTVC-BENCH-CORPUS:linux-main-100k-v1-e0bd41dc-8e12-4f1b-978d-a3645ae59da0
config IEEE80211_SOFTMAC
	tristate "Software MAC add-on to the IEEE 802.11 networking stack"
	depends on IEEE80211 && EXPERIMENTAL
	select WIRELESS_EXT
	select IEEE80211_CRYPT_WEP
	---help---
	This option enables the hardware independent software MAC addon
	for the IEEE 802.11 networking stack.

config IEEE80211_SOFTMAC_DEBUG
	bool "Enable full debugging output"
	depends on IEEE80211_SOFTMAC
```

## net/iucv/Kconfig
```kconfig
FASTVC-BENCH-CORPUS:linux-main-100k-v1-e0bd41dc-8e12-4f1b-978d-a3645ae59da0
config IUCV
	tristate "IUCV support (VM only)"
	depends on S390
	help
	  Select this option if you want to use inter-user communication under
	  VM or VIF sockets. If you run on z/VM, say "Y" to enable a fast
	  communication link between VM guests.
```

## net/netfilter/Kconfig
```kconfig
FASTVC-BENCH-CORPUS:linux-main-100k-v1-e0bd41dc-8e12-4f1b-978d-a3645ae59da0
config NETFILTER_NETLINK
       tristate "Netfilter netlink interface"
       help
         If this option is enabled, the kernel will include support
         for the new netfilter netlink interface.

config NETFILTER_NETLINK_QUEUE
	tristate "Netfilter NFQUEUE over NFNETLINK interface"
	depends on NETFILTER_NETLINK
	help
	  If this option isenabled, the kernel will include support
	  for queueing packets via NFNETLINK.
	  
```

## net/netlabel/Kconfig
```kconfig
FASTVC-BENCH-CORPUS:linux-main-100k-v1-e0bd41dc-8e12-4f1b-978d-a3645ae59da0
#
# NetLabel configuration
#

config NETLABEL
	bool "NetLabel subsystem support"
	depends on NET && SECURITY
	default n
	---help---
	  NetLabel provides support for explicit network packet labeling
	  protocols such as CIPSO and RIPSO.  For more information see
	  Documentation/netlabel.

	  If you are unsure, say N.
```
